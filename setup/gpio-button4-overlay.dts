/dts-v1/;
/plugin/;

/ {
    compatible = "brcm,bcm2708";

    fragment@0 {
        target = <&gpio>;
        __overlay__ {
            pinctrl-names = "default";
            pinctrl-0 = <&button_4>;

            button_4: button_4 {
                brcm,pins = <4>;     /* gpio no. */
                brcm,function = <0>; /* 0:in, 1:out */
                brcm,pull = <2>;     /* 2:up 1:down 0:none */
            };
        };
    };
};
